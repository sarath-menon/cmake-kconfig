## Kconfig
```kconfig
menu "Build and debug options"

config MODULE_1
	bool "Module 1"
	help
	  1998 C++ standard as modified by the 2003 technical corrigendum
	  and some later defect reports.

config MODULE_2
	bool "Module 2"
	help
	  2011 C++ standard, previously known as C++0x.

endmenu
```

## configs/Kconfig
```kconfig
menuconfig CPLUSPLUS
	bool "C++ support for the application"
	help
	  This option enables the use of applications built with C++.

if CPLUSPLUS

choice
	prompt "C++ Standard"
	default STD_CPP11
	help
	  C++ Standards.

config STD_CPP98
	bool "C++ 98"
	help
	  1998 C++ standard as modified by the 2003 technical corrigendum
	  and some later defect reports.

config STD_CPP11
	bool "C++ 11"
	help
	  2011 C++ standard, previously known as C++0x.
endchoice

config MY_CONFIG_OPTION
    int "My config option"
    range 0 255
    default 64
    help
      Enter the valu which wil be assigned to uint8_t variable

config LIB_CPLUSPLUS
	bool "Link with STD C++ library"
	depends on !MINIMAL_LIBC
	help
	  Link with STD C++ Library.

if LIB_CPLUSPLUS

config EXCEPTIONS
	bool "C++ exceptions support"
	depends on !NEWLIB_LIBC_NANO
	help
	  This option enables support of C++ exceptions.

config RTTI
	bool "C++ RTTI support"
	help
	  This option enables support of C++ RTTI.

endif # LIB_CPLUSPLUS

config CPP_STATIC_INIT_GNU
	# As of today only ARC MWDT toolchain doesn't support GNU-compatible
	# initialization of CPP static objects, new toolchains can be added
	# here if required.
	def_bool "$(ZEPHYR_TOOLCHAIN_VARIANT)" != "arcmwdt"
	help
	  GNU-compatible initialization of CPP static objects

endif # CPLUSPLUS


config TEST_OPTION
	bool "enable testing"
	default n
	help
	  Enables unit tests
```
